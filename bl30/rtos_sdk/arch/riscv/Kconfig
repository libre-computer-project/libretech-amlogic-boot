## bl30/rtos_sdk/arch/riscv/Kconfig
```kconfig
# Copyright (c) 2021-2022 Amlogic, Inc. All rights reserved.

# SPDX-License-Identifier: MIT

menu "RISCV Options"

config RISCV
	bool
	select KERNEL
	help
	  RISC-V architecture

config VERSION_FULL_INFO
	bool "Version full information"
	help
	  Select print full version information.

config AOCPU_ALIVE_DETECTION
	bool "AOCPU alive detection mechanism"
	help
	  Record AOCPU tickcount to register.

config RISCV_WCN
	bool "RISCV for WCN"
	help
	  RISCV for WCN.

endmenu
```

## bl33/v2015/board/amlogic/defconfigs/sm1_s905d3_cm_defconfig
```kconfig
CONFIG_ARM=y
CONFIG_TARGET_MESON_G12A=y
CONFIG_SM1_S905D3_CM=y
CONFIG_DM=y
CONFIG_DM_GPIO=y
CONFIG_AML_GPIO=y
```

## bl33/v2019/board/amlogic/c3_aw402s/Kconfig
```kconfig
if TARGET_C3_AW402S

config SYS_SOC
	default "c3"

config SYS_BOARD
	default "c3_aw402s"

config SYS_VENDOR
	default "amlogic"

config SYS_CONFIG_NAME
	default "c3_aw402s"

config DTB_BIND_KERNEL
    bool "load dtb from boot part but not flash rsv"
    default n

config AML_REBOOT
    bool "reboot cmd"
    default y
    help
    support uboot reboot cmd
endif
```

## bl33/v2019/board/amlogic/t3x_bc302/Kconfig
```kconfig
if TARGET_T3X_BC302

config SYS_SOC
	default "t3x"

config SYS_BOARD
	default "t3x_bc302"

config SYS_VENDOR
	default "amlogic"

config ENV_DISPLAY_PIPELINE
	string
	option env="BOARD_DISPLAY_PIPELINE"

config DISPLAY_PIPELINE
	string
	default "multidisplay" if ENV_DISPLAY_PIPELINE="multidisplay"

config SYS_CONFIG_NAME
	default "t3x_bc302" if ENV_DISPLAY_PIPELINE!="multidisplay"
	default "t3x_bc302_multidisplay" if ENV_DISPLAY_PIPELINE="multidisplay"

config DTB_BIND_KERNEL
    bool "load dtb from boot part but not flash rsv"
    default n

config AML_REBOOT
       bool "reboot cmd"
       default y
       help
         support uboot reboot cmd
endif
```

## bl33/v2019/board/amlogic/t3x_bc303/Kconfig
```kconfig
if TARGET_T3X_BC303

config SYS_SOC
	default "t3x"

config SYS_BOARD
	default "t3x_bc303"

config SYS_VENDOR
	default "amlogic"

config ENV_DISPLAY_PIPELINE
	string
	option env="BOARD_DISPLAY_PIPELINE"

config DISPLAY_PIPELINE
	string
	default "multidisplay" if ENV_DISPLAY_PIPELINE="multidisplay"

config SYS_CONFIG_NAME
	default "t3x_bc303" if ENV_DISPLAY_PIPELINE!="multidisplay"
	default "t3x_bc303_multidisplay" if ENV_DISPLAY_PIPELINE="multidisplay"

config DTB_BIND_KERNEL
    bool "load dtb from boot part but not flash rsv"
    default n

config AML_REBOOT
       bool "reboot cmd"
       default y
       help
         support uboot reboot cmd
endif
```
